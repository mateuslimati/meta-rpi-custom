## conf/machine/scorpion-rpi.conf
```bitbake
#@TYPE: Machine
#@NAME: Scorpion machine
#@DESCRIPTION: Machine configuration for the RaspberryPi 3B+ in 64 bits mode

MACHINEOVERRIDES =. "raspberrypi3-64:"

include conf/machine/raspberrypi3-64.conf
```
